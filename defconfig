## defconfig
```kconfig
# compile error workaround
CONFIG_CRYPTO_CRC32C=y
CONFIG_LIBCRC32C=y

# ext4 support
CONFIG_EXT4_FS=y
CONFIG_EXT4_DEBUG=n
CONFIG_EXT4_FS_POSIX_ACL=n
CONFIG_EXT4_FS_SECURITY=n
CONFIG_FS_MBCACHE=y
CONFIG_JBD2=y
CONFIG_JBD2_DEBUG=n

# devtmpfs
CONFIG_DEVTMPFS=y
CONFIG_DEVTMPFS_MOUNT=y

# unix domain sockets
CONFIG_UNIX=y
CONFIG_UNIX_DIAG=n

# merge OpenEmbedded defconfig
CONFIG_ASYNC_TX_DMA=y
CONFIG_BONDING=y
CONFIG_BRIDGE=y
CONFIG_BTRFS_FS=y
CONFIG_CPU_IDLE=y
CONFIG_CRYPTO_CBC=y
CONFIG_CRYPTO_DEFLATE=y
CONFIG_CRYPTO_DES=y
CONFIG_CRYPTO_HMAC=y
CONFIG_CRYPTO_LZO=y
CONFIG_CRYPTO_MD5=y
CONFIG_CRYPTO_PCBC=y
CONFIG_CRYPTO_SHA1=y
CONFIG_DEBUG_LL=y
CONFIG_DEBUG_LL_INCLUDE="debug/mvebu.S"
CONFIG_E1000=y
CONFIG_E1000E=y
CONFIG_I2C_CHARDEV=y
CONFIG_IPV6=y
CONFIG_IP_PNP=y
CONFIG_JFFS2_FS=y
CONFIG_LOG_BUF_SHIFT=16
CONFIG_MD=y
CONFIG_MTD_BLKDEVS=y
CONFIG_MTD_BLOCK=y
CONFIG_MTD_CMDLINE_PARTS=y
CONFIG_MTD_NAND_MVEBU_NFC=y
CONFIG_MTD_UBI=y
CONFIG_MVPP2=y
CONFIG_MV_ETH_DEBUG_CODE=y
CONFIG_MV_ETH_GRO_DEF=y
CONFIG_MV_ETH_HWF=n
CONFIG_MV_ETH_NAPI_GROUPS=4
CONFIG_MV_ETH_PNC_WOL=y
CONFIG_MV_ETH_PORTS_NUM=4
CONFIG_MV_ETH_RXQ=8
CONFIG_MV_ETH_RXQ_DESC=256
CONFIG_MV_ETH_STAT_DBG=y
CONFIG_MV_ETH_TSO_DEF=y
CONFIG_MV_ETH_TXQ=8
CONFIG_MV_NETA_SKB_RECYCLE_DEF=0
CONFIG_MV_PP2_DEBUG_CODE=y
CONFIG_MV_PP2_SKB_RECYCLE_DEF=0
CONFIG_MV_PP2_STAT_DBG=y
CONFIG_NFSD=y
CONFIG_NFS_FS=y
CONFIG_ PACKET=y
CONFIG_PHONE=y
CONFIG_PPS=y
CONFIG_PTP_1588_CLOCK=y
CONFIG_SATA_AHCI=y
CONFIG_SATA_AHCI_MV=y
CONFIG_SCHED_MC=y
CONFIG_SOUND=y
CONFIG_SQUASHFS=y
CONFIG_TUN=m
CONFIG_VLAN_8021Q=y
CONFIG_WATCHDOG=y
CONFIG_ALIM7101_WDT=n
CONFIG_ARM_MVEBU_V7_CPUIDLE=n
CONFIG_ASYNC_CORE=y
CONFIG_ASYNC_MEMCPY=y
CONFIG_ASYNC_PQ=y
CONFIG_ASYNC_RAID6_RECOV=y
CONFIG_ASYNC_RAID6_TEST=n
CONFIG_ASYNC_XOR=y
CONFIG_BCACHE=n
CONFIG_BLK_DEV_DM=y
CONFIG_BLK_DEV_DM_BUILTIN=y
CONFIG_BLK_DEV_MD=y
CONFIG_BRIDGE_IGMP_SNOOPING=y
CONFIG_BRIDGE_NETFILTER=y
CONFIG_BRIDGE_NF_EBTABLES=n
CONFIG_BRIDGE_VLAN_FILTERING=n
CONFIG_BTRFS_DEBUG=n
CONFIG_BTRFS_FS_CHECK_INTEGRITY=n
CONFIG_BTRFS_FS_POSIX_ACL=n
CONFIG_BTRFS_FS_RUN_SANITY_TESTS=n
CONFIG_CPU_IDLE_GOV_LADDER=y
CONFIG_CPU_IDLE_MULTIPLE_DRIVERS=n
CONFIG_DEBUG_ICEDCC=n
CONFIG_DEBUG_MVEBU_UART=n
CONFIG_DEBUG_MVEBU_UART_ALTERNATE=y
CONFIG_DEBUG_SEMIHOSTING=n
CONFIG_DEBUG_UNCOMPRESS=y
CONFIG_DM_CACHE=n
CONFIG_DM_CRYPT=y
CONFIG_DM_DEBUG=n
CONFIG_DM_DELAY=n
CONFIG_DM_FLAKEY=n
CONFIG_DM_MIRROR=n
CONFIG_DM_MULTIPATH=n
CONFIG_DM_RAID=n
CONFIG_DM_SNAPSHOT=n
CONFIG_DM_THIN_PROVISIONING=n
CONFIG_DM_UEVENT=n
CONFIG_DM_VERITY=n
CONFIG_DM_ZERO=n
CONFIG_DW_WATCHDOG=n
CONFIG_EARLY_PRINTK=y
CONFIG_HID_PRODIKEYS=n
CONFIG_I6300ESB_WDT=n
CONFIG_IP_PNP_BOOTP=y
CONFIG_IP_PNP_DHCP=y
CONFIG_IP_PNP_RARP=y
CONFIG_JFFS2_COMPRESSION_OPTIONS=n
CONFIG_JFFS2_FS_DEBUG=0
CONFIG_JFFS2_FS_WBUF_VERIFY=n
CONFIG_JFFS2_FS_WRITEBUFFER=y
CONFIG_JFFS2_FS_XATTR=n
CONFIG_JFFS2_LZO=n
CONFIG_JFFS2_RTIME=y
CONFIG_JFFS2_RUBIN=n
CONFIG_JFFS2_SUMMARY=n
CONFIG_JFFS2_ZLIB=y
CONFIG_LLC=y
CONFIG_LOCKD=y
CONFIG_LOCKD_V4=y
CONFIG_LZO_COMPRESS=y
CONFIG_LZO_DECOMPRESS=y
CONFIG_MAX63XX_WATCHDOG=n
CONFIG_MD_AUTODETECT=y
CONFIG_MD_FAULTY=n
CONFIG_MD_LINEAR=n
CONFIG_MD_MULTIPATH=n
CONFIG_MD_RAID0=y
CONFIG_MD_RAID1=y
CONFIG_MD_RAID10=n
CONFIG_MD_RAID456=y
CONFIG_MPCORE_WATCHDOG=n
CONFIG_MTD_NAND_MARVELL=y
CONFIG_MTD_NAND_NFC=y
CONFIG_MTD_NAND_NFC_GANG_SUPPORT=n
CONFIG_MTD_NAND_NFC_INIT_RESET=y
CONFIG_MTD_NAND_NFC_MLC_SUPPORT=y
CONFIG_MTD_NAND_NFC_NEGLECT_RNB=n
CONFIG_MTD_UBI_BEB_LIMIT=20
CONFIG_MTD_UBI_FASTMAP=n
CONFIG_MTD_UBI_GLUEBI=n
CONFIG_MTD_UBI_WL_THRESHOLD=4096
CONFIG_MV_ETH_3_MACADDR="00:00:00:00:00:83"
CONFIG_MV_ETH_3_MTU=1500
CONFIG_MV_ETH_BM_PORT_3=y
CONFIG_MV_ETH_BM_PORT_3_LONG_BUF_NUM=2048
CONFIG_MV_ETH_BM_PORT_3_LONG_POOL=3
CONFIG_MV_ETH_BM_PORT_3_SHORT_POOL=3
CONFIG_MV_ETH_GROUP1_CPU=0x0
CONFIG_MV_ETH_GROUP1_RXQ=0x0
CONFIG_MV_ETH_GROUP2_CPU=0x0
CONFIG_MV_ETH_GROUP2_RXQ=0x0
CONFIG_MV_ETH_GROUP3_CPU=0x0
CONFIG_MV_ETH_GROUP3_RXQ=0x0
CONFIG_MV_INCLUDE_TDM=y
CONFIG_MV_NETA_DEBUG_CODE=y
CONFIG_MV_TDM2C_SUPPORT=y
CONFIG_MV_TDM_EXT_STATS=y
CONFIG_NFSD_V3=y
CONFIG_NFSD_V3_ACL=n
CONFIG_NFS_COMMON=y
CONFIG_NFS_SWAP=n
CONFIG_NFS_V2=y
CONFIG_NFS_V3=y
CONFIG_NFS_V3_ACL=n
CONFIG_NFS_V4=y
CONFIG_NTP_PPS=n
CONFIG_ORION_WATCHDOG=y
CONFIG_PACKET_DIAG=n
CONFIG_PCIPCWATCHDOG=n
CONFIG_PPS_CLIENT_GPIO=n
CONFIG_PPS_CLIENT_KTIMER=n
CONFIG_PPS_CLIENT_LDISC=n
CONFIG_PPS_DEBUG=n
CONFIG_RAID6_PQ=y
CONFIG_REGMAP=y
CONFIG_REGMAP_I2C=y
CONFIG_REGMAP_SPI=y
CONFIG_ROOT_NFS=y
CONFIG_SENSORS_SCH5627=n
CONFIG_SENSORS_SCH5636=n
CONFIG_SND=y
CONFIG_SND_AD1889=n
CONFIG_SND_ALI5451=n
CONFIG_SND_ALOOP=n
CONFIG_SND_ALS300=n
CONFIG_SND_ARM=y
CONFIG_SND_ATIIXP=n
CONFIG_SND_ATIIXP_MODEM=n
CONFIG_SND_ATMEL_SOC=n
CONFIG_SND_AU8810=n
CONFIG_SND_AU8820=n
CONFIG_SND_AU8830=n
CONFIG_SND_AW2=n
CONFIG_SND_AZT3328=n
CONFIG_SND_BT87X=n
CONFIG_SND_CA0106=n
CONFIG_SND_CMIPCI=n
CONFIG_SND_COMPRESS_OFFLOAD=y
CONFIG_SND_CS4281=n
CONFIG_SND_CS46XX=n
CONFIG_SND_CS5535AUDIO=n
CONFIG_SND_CTXFI=n
CONFIG_SND_DARLA20=n
CONFIG_SND_DARLA24=n
CONFIG_SND_DEBUG=n
CONFIG_SND_DESIGNWARE_I2S=n
CONFIG_SND_DRIVERS=y
CONFIG_SND_DUMMY=n
CONFIG_SND_DYNAMIC_MINORS=n
CONFIG_SND_ECHO3G=n
CONFIG_SND_EMU10K1=n
CONFIG_SND_EMU10K1X=n
CONFIG_SND_EMU10K1_SEQ=n
CONFIG_SND_ENS1370=n
CONFIG_SND_ENS1371=n
CONFIG_SND_ES1938=n
CONFIG_SND_ES1968=n
CONFIG_SND_FM801=n
CONFIG_SND_GINA20=n
CONFIG_SND_GINA24=n
CONFIG_SND_HDA_INTEL=n
CONFIG_SND_HDSP=n
CONFIG_SND_HDSPM=n
CONFIG_SND_HRTIMER=n
CONFIG_SND_ICE1712=n
CONFIG_SND_ICE1724=n
CONFIG_SND_INDIGO=n
CONFIG_SND_INDIGODJ=n
CONFIG_SND_INDIGODJX=n
CONFIG_SND_INDIGOIO=n
CONFIG_SND_INDIGOIOX=n
CONFIG_SND_INTEL8X0=n
CONFIG_SND_INTEL8X0M=n
CONFIG_SND_JACK=y
CONFIG_SND_KIRKWOOD_SOC=y
CONFIG_SND_KIRKWOOD_SOC_ARMADA370_DB=y
CONFIG_SND_KORG1212=n
CONFIG_SND_LAYLA20=n
CONFIG_SND_LAYLA24=n
CONFIG_SND_LOLA=n
CONFIG_SND_LX6464ES=n
CONFIG_SND_MAESTRO3=n
CONFIG_SND_MIA=n
CONFIG_SND_MIXART=n
CONFIG_SND_MIXER_OSS=n
CONFIG_SND_MONA=n
CONFIG_SND_MPU401=n
CONFIG_SND_MTPAV=n
CONFIG_SND_NM256=n
CONFIG_SND_OPL3_LIB_SEQ=n
CONFIG_SND_OPL4_LIB_SEQ=n
CONFIG_SND_OXYGEN=n
CONFIG_SND_PCI=y
CONFIG_SND_PCM=y
CONFIG_SND_PCM_OSS=n
CONFIG_SND_PCXHR=n
CONFIG_SND_RAWMIDI_SEQ=n
CONFIG_SND_RIPTIDE=n
CONFIG_SND_RME32=n
CONFIG_SND_RME96=n
CONFIG_SND_RME9652=n
CONFIG_SND_SBAWE_SEQ=n
CONFIG_SND_SEQUENCER=n
CONFIG_SND_SERIAL_U16550=n
CONFIG_SND_SIMPLE_CARD=n
CONFIG_SND_SOC=y
CONFIG_SND_SOC_ALL_CODECS=n
CONFIG_SND_SOC_CS42L51=y
CONFIG_SND_SOC_I2C_AND_SPI=y
CONFIG_SND_SOC_SPDIF=y
CONFIG_SND_SONICVIBES=n
CONFIG_SND_SPI=y
CONFIG_SND_SUPPORT_OLD_API=y
CONFIG_SND_TIMER=y
CONFIG_SND_TRIDENT=n
CONFIG_SND_USB=y
CONFIG_SND_USB_6FIRE=n
CONFIG_SND_USB_AUDIO=n
CONFIG_SND_USB_CAIAQ=n
CONFIG_SND_USB_UA101=n
CONFIG_SND_VERBOSE_PRINTK=n
CONFIG_SND_VERBOSE_PROCFS=y
CONFIG_SND_VIA82XX=n
CONFIG_SND_VIA82XX_MODEM=n
CONFIG_SND_VIRTUOSO=n
CONFIG_SND_VX222=n
CONFIG_SND_YMFPCI=n
CONFIG_SOFT_WATCHDOG=n
CONFIG_SOUND_OSS_CORE=n
CONFIG_SOUND_PRIME=n
CONFIG_SQUASHFS_4K_DEVBLK_SIZE=n
CONFIG_SQUASHFS_EMBEDDED=n
CONFIG_SQUASHFS_FRAGMENT_CACHE_SIZE 3
CONFIG_SQUASHFS_LZO=n
CONFIG_SQUASHFS_XATTR=n
CONFIG_SQUASHFS_XZ=n
CONFIG_SQUASHFS_ZLIB=y
CONFIG_STP=y
CONFIG_SUNRPC=y
CONFIG_SUNRPC_DEBUG=n
CONFIG_UBIFS_FS=y
CONFIG_UBIFS_FS_ADVANCED_COMPR=y
CONFIG_UBIFS_FS_LZO=y
CONFIG_UBIFS_FS_ZLIB=y
CONFIG_USBPCWATCHDOG=n
CONFIG_VLAN_8021Q_GVRP=n
CONFIG_VLAN_8021Q_MVRP=n
CONFIG_WATCHDOG_CORE=y
CONFIG_WATCHDOG_NOWAYOUT=n
CONFIG_WDTPCI=n
CONFIG_XOR_BLOCKS=y
CONFIG_ZLIB_DEFLATE=y
```
